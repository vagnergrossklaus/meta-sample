## conf/distro/spe.conf
```bitbake
DISTRO = "spe"
DISTRO_NAME = "Sample Distro"
DISTRO_VERSION = "0.0.1"

DISTRO_FEATURES = " \
    systemd \
    usrmerge \
"
DISTRO_FEATURES_BACKFILL_CONSIDERED = "pulseaudio sysvinit gobject-introspection-data ldconfig"

VIRTUAL-RUNTIME_init_manager = "systemd"
```
